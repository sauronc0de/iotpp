## firmware/config/Kconfig.projbuild
```kconfig
menu "OTA updates (Mew)"
    visible if TASK_OTA

    config OTA_MANIFEST_URL
        string "HTTPS manifest URL (empty disables network checks)"
        default ""

    config OTA_CHECK_INTERVAL_SECONDS
        int "Automatic check interval in seconds (0 = manual only)"
        range 0 2592000
        default 21600

    config OTA_PERIPHERAL_ID
        int "Mew peripheral instance ID (type is always 151)"
        range 0 255
        default 2

    config OTA_BOOT_VALIDATION_SECONDS
        int "Local boot observation window before confirming firmware"
        range 5 120
        default 30

endmenu

menu "Sentinel WiFi and DEX"

    config SENTINEL_WIFI_SSID
        string "WiFi SSID"
        default ""

    config SENTINEL_WIFI_PASSWORD
        string "WiFi password"
        default ""
        help
            Leave empty for an open network.

    config SENTINEL_UDP_PORT
        int "DEX UDP listen port"
        depends on TASK_SERVER_DEX
        range 1 65535
        default 4444

endmenu

menu "Door GPIO monitoring"
    visible if TASK_MONITOR_DOOR

    config DOOR_MONITOR_GPIO
        int "Magnetic sensor RTC GPIO"
        range 0 39
        default 33
        help
            Must support EXT0 wakeup. On ESP32: 0, 2, 4, 12-15, 25-27, 32-39.
            Use a dedicated pin, not one assigned to another task or peripheral.

    config DOOR_MONITOR_OPEN_LEVEL
        int "GPIO level when the door is open"
        range 0 1
        default 1

    config DOOR_MONITOR_INTERNAL_PULL
        bool "Enable internal pull towards the open level"
        default y
        help
            With open level 1, connect the normally closed contact to GND.
            With open level 0, connect it to 3.3V. Disable for an external
            pull resistor (required on ESP32 GPIO34-39).

    config DOOR_MONITOR_SAMPLE_PERIOD_MS
        int "GPIO reading interval (ms)"
        range 10 1000
        default 20

    config DOOR_MONITOR_CLOSED_READINGS
        int "Consecutive closed readings required"
        range 2 100
        default 5

    config DOOR_MONITOR_HOST
        string "Door event receiver hostname or IPv4 (required)"
        default ""

    config DOOR_MONITOR_PORT
        int "Door event receiver UDP port"
        range 1 65535
        default 4444

    config DOOR_MONITOR_PERIPHERAL_ID
        int "Door peripheral instance ID"
        range 0 255
        default 1

    config DOOR_MONITOR_TX_GRACE_MS
        int "Delay after local UDP completion before Deep Sleep (ms)"
        range 100 5000
        default 250
        help
            Allows Wi-Fi to transmit queued packets. UDP completion is not
            an acknowledgement from the receiver. Network failures keep the
            device awake and retrying; Deep Sleep affects every running task.

endmenu

menu "rbAmp Pikachu monitoring"
    visible if TASK_MONITOR_RBAMP

    config RBAMP_MONITOR_SDA_GPIO
        int "I2C SDA GPIO"
        range 0 33
        default 21

    config RBAMP_MONITOR_SCL_GPIO
        int "I2C SCL GPIO"
        range 0 33
        default 22

    config RBAMP_MONITOR_I2C_PORT
        int "I2C controller"
        range 0 1
        default 0

    config RBAMP_MONITOR_ADDRESS
        hex "rbAmp 7-bit I2C address"
        range 0x08 0x77
        default 0x50

    config RBAMP_MONITOR_CT_MODEL
        int "SCT-013 model code (-1 preserves device configuration)"
        range -1 255
        default -1
        help
            Use the model code from the rbAmp sensor registry. An unconfigured
            module needs an explicit model. Factory-paired sensors are preserved;
            selecting an SCT-013 model for those modules is rejected.

    config RBAMP_MONITOR_PERIPHERAL_ID
        int "Pikachu peripheral instance ID"
        range 0 255
        default 0

    config RBAMP_MONITOR_SAMPLE_PERIOD_MS
        int "Sample period (ms)"
        range 1000 60000
        default 1000
        help
            Valid samples accumulate until the publication deadline and are
            sent in a burst, without waiting for a receiver response. Samples
            wait in the FIFO during local network failures, for up to one hour.
            The fixed three-channel BASIC format uses 62 bytes per FIFO entry.
            At 1 Hz, the one-hour FIFO needs 223262 bytes including one spare
            entry. Startup reports insufficient RAM and the free/largest block.

    config RBAMP_MONITOR_PUBLISH_PERIOD_MS
        int "Monitoring burst period (ms)"
        range 1000 3600000
        default 10000

    config RBAMP_MONITOR_HOST
        string "Monitoring receiver hostname or IPv4 (empty disables sending)"
        default ""

    config RBAMP_MONITOR_PORT
        int "Monitoring receiver UDP port"
        range 1 65535
        default 4444

endmenu

menu "Monitoring UTC clock"
    config MONITORING_NTP_SERVER
        string "Internet NTP server"
        default "pool.ntp.org"
        help
            Monitoring tasks start only after the first UTC synchronization.
            The shared system clock is periodically resynchronized by SNTP.
endmenu
```

## src/config/Kconfig.projbuild
```kconfig
menu "Sentinel WiFi and DEX"

    config SENTINEL_WIFI_SSID
        string "WiFi SSID"
        default ""

    config SENTINEL_WIFI_PASSWORD
        string "WiFi password"
        default ""
        help
            Leave empty for an open network.

    config SENTINEL_UDP_PORT
        int "DEX UDP listen port"
        range 1 65535
        default 4444

endmenu

menu "rbAmp Pikachu monitoring"

    config RBAMP_MONITOR_SDA_GPIO
        int "I2C SDA GPIO"
        range 0 33
        default 21

    config RBAMP_MONITOR_SCL_GPIO
        int "I2C SCL GPIO"
        range 0 33
        default 22

    config RBAMP_MONITOR_I2C_PORT
        int "I2C controller"
        range 0 1
        default 0

    config RBAMP_MONITOR_ADDRESS
        hex "rbAmp 7-bit I2C address"
        range 0x08 0x77
        default 0x50

    config RBAMP_MONITOR_CT_MODEL
        int "SCT-013 model code (-1 preserves device configuration)"
        range -1 255
        default -1
        help
            Use the model code from the rbAmp sensor registry. An unconfigured
            module needs an explicit model. Factory-paired sensors are preserved;
            selecting an SCT-013 model for those modules is rejected.

    config RBAMP_MONITOR_PERIPHERAL_ID
        int "Pikachu peripheral instance ID"
        range 0 255
        default 0

    config RBAMP_MONITOR_SAMPLE_PERIOD_MS
        int "Sample period (ms)"
        range 1000 60000
        default 1000
        help
            Every successful sample is retained for up to one hour until ACKed.
            The fixed three-channel BASIC format uses 62 bytes per FIFO entry.
            At 1 Hz, the one-hour FIFO needs 223262 bytes including one spare
            entry. Startup reports insufficient RAM and the free/largest block.

    config RBAMP_MONITOR_PUBLISH_PERIOD_MS
        int "Publication period (ms)"
        range 1000 3600000
        default 10000

    config RBAMP_MONITOR_HOST
        string "Monitoring receiver hostname or IPv4 (empty disables sending)"
        default ""

    config RBAMP_MONITOR_PORT
        int "Monitoring receiver UDP port"
        range 1 65535
        default 4444

    config RBAMP_MONITOR_NTP_SERVER
        string "Internet NTP server for initial UTC and hourly resynchronization"
        default "pool.ntp.org"

endmenu
```
